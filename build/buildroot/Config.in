## build/buildroot/Config.in
```kconfig
################################################################################
# build/buildroot/Config.in — top-level Kconfig for AIOS-Lite external tree
################################################################################

menu "AIOS-Lite packages"
    source "$BR2_EXTERNAL_AIOS_PATH/package/aios-lite/Config.in"
endmenu
```

## build/buildroot/configs/aios_arm64_s21fe_defconfig
```kconfig
# build/buildroot/configs/aios_arm64_s21fe_defconfig
# Buildroot defconfig for AIOS-Lite on ARM64 / Samsung Galaxy S21 FE
#
# Target: aarch64 (Cortex-A78 big cores, 6–8 GB RAM variant)
# CPU affinity for LLM inference: cores 1–3 (big cluster)
# Thermal limit: 68 °C  (see config/llama-settings.conf)
#
# Usage (cross-compile on x86-64 host):
#   cd buildroot/
#   make BR2_EXTERNAL=<path-to>/build/buildroot aios_arm64_s21fe_defconfig
#   make

BR2_aarch64=y
BR2_TOOLCHAIN_EXTERNAL=y
BR2_TOOLCHAIN_EXTERNAL_PREINSTALLED=y
BR2_TOOLCHAIN_EXTERNAL_CUSTOM_PREFIX="aarch64-linux-gnu"

# Device identity
BR2_TARGET_GENERIC_HOSTNAME="aioscpu-s21fe"
BR2_TARGET_GENERIC_ISSUE="AIOSCPU v1.0.0 (Aurora) — Samsung Galaxy S21 FE"

# Init system
BR2_INIT_SYSTEMD=y
BR2_PACKAGE_SYSTEMD=y

# Shell & scripting
BR2_PACKAGE_BASH=y
BR2_PACKAGE_BASH_COMPLETION=y

# Python AI core
BR2_PACKAGE_PYTHON3=y
BR2_PACKAGE_PYTHON3_PY_PYC=y
BR2_PACKAGE_PYTHON_CRYPTOGRAPHY=y

# Network
BR2_PACKAGE_IPROUTE2=y
BR2_PACKAGE_OPENSSH=y
BR2_PACKAGE_WIREGUARD_TOOLS=y
BR2_PACKAGE_AVAHI=y
BR2_PACKAGE_BLUEZ5_UTILS=y

# Utilities
BR2_PACKAGE_SUDO=y
BR2_PACKAGE_RSYNC=y
BR2_PACKAGE_CURL=y

# S21 FE device profile is selected at runtime via config/device-profiles/samsung-s21fe.conf
# LLAMA_CPU_AFFINITY is set to "1-3" in that profile (big Cortex-A78 cores)

# AIOS-Lite
BR2_PACKAGE_AIOS_LITE=y
```

## build/buildroot/configs/aios_x86_64_defconfig
```kconfig
# build/buildroot/configs/aios_x86_64_defconfig
# Buildroot defconfig for AIOS-Lite on x86-64 (hosted / AIOSCPU desktop build)
#
# Usage:
#   cd buildroot/
#   make BR2_EXTERNAL=<path-to>/build/buildroot aios_x86_64_defconfig
#   make

BR2_x86_64=y
BR2_TOOLCHAIN_EXTERNAL=y
BR2_TOOLCHAIN_EXTERNAL_PREINSTALLED=y

# System
BR2_TARGET_GENERIC_HOSTNAME="aioscpu"
BR2_TARGET_GENERIC_ISSUE="AIOSCPU v1.0.0 (Aurora) - AI Operating System"
BR2_ROOTFS_POST_BUILD_SCRIPT=""

# Filesystem / init
BR2_INIT_SYSTEMD=y
BR2_PACKAGE_SYSTEMD=y

# Shell & scripting
BR2_PACKAGE_BASH=y
BR2_PACKAGE_BASH_COMPLETION=y

# Python (required by AI core)
BR2_PACKAGE_PYTHON3=y
BR2_PACKAGE_PYTHON3_PY_PYC=y
BR2_PACKAGE_PYTHON_CRYPTOGRAPHY=y

# Network tools
BR2_PACKAGE_IPROUTE2=y
BR2_PACKAGE_OPENSSH=y
BR2_PACKAGE_WIREGUARD_TOOLS=y
BR2_PACKAGE_AVAHI=y
BR2_PACKAGE_BLUEZ5_UTILS=y

# Utilities
BR2_PACKAGE_SUDO=y
BR2_PACKAGE_VIM=y
BR2_PACKAGE_GIT=y
BR2_PACKAGE_RSYNC=y
BR2_PACKAGE_CURL=y
BR2_PACKAGE_XORRISO=y

# Bootloader
BR2_TARGET_GRUB2=y
BR2_TARGET_GRUB2_I386_PC=y
BR2_TARGET_GRUB2_BUILTIN_MODULES_I386_PC="boot linux ext2 fat part_msdos part_gpt normal echo"

# AIOS-Lite
BR2_PACKAGE_AIOS_LITE=y
```

## build/buildroot/package/aios-lite/Config.in
```kconfig
################################################################################
# build/buildroot/package/aios-lite/Config.in
################################################################################

config BR2_PACKAGE_AIOS_LITE
    bool "aios-lite"
    depends on BR2_PACKAGE_BASH
    depends on BR2_PACKAGE_PYTHON3
    help
      Install AIOS-Lite into /opt/aios on the target rootfs.
      Requires bash and python3.
```
